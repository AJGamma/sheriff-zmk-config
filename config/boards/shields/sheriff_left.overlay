

#include "sheriff.dtsi"

&kscan0 {
    diode-direction = "col2row";

    // top to bottom
    row-gpios
        = <&pro_micro 5 (GPIO_ACTIVE_HIGH | GPIO_PULL_DOWN)>  // ROW 0 (NUM)
        , <&pro_micro 6 (GPIO_ACTIVE_HIGH | GPIO_PULL_DOWN)>  // ROW 1 (UPPER)
        , <&pro_micro 7 (GPIO_ACTIVE_HIGH | GPIO_PULL_DOWN)>  // ROW 2 (HOME)
        , <&pro_micro 8 (GPIO_ACTIVE_HIGH | GPIO_PULL_DOWN)>  // ROW 3 (LOWER)
        , <&pro_micro 9 (GPIO_ACTIVE_HIGH | GPIO_PULL_DOWN)>  // ROW 4 (THUMB + ROT)
        ;

    // left to right    
    col-gpios
        = <&pro_micro 20 GPIO_ACTIVE_HIGH>  // COL 0 (outer2)
        , <&pro_micro 19 GPIO_ACTIVE_HIGH>  // COL 1 (outer1)
        , <&pro_micro 18 GPIO_ACTIVE_HIGH>  // COL 2 (pinky)
        , <&pro_micro 15 GPIO_ACTIVE_HIGH>  // COL 3 (ring)
        , <&pro_micro 14 GPIO_ACTIVE_HIGH>  // COL 4 (middle)
        , <&pro_micro 16 GPIO_ACTIVE_HIGH>  // COL 5 (index)
        , <&pro_micro 10 GPIO_ACTIVE_HIGH>  // COL 6 (inner)
        ;
};

&encoder_left {
    status = "okay";
};
