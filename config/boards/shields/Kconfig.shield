## config/boards/shields/Kconfig.shield
```kconfig
config SHIELD_SHERIFF_LEFT
    def_bool $(shields_list_contains, sheriff_left)

config SHIELD_SHERIFF_RIGHT
    def_bool $(shields_list_contains, sheriff_right)
```

## config/boards/shields/sheriff/Kconfig.defconfig
```kconfig
if SHIELD_SHERIFF_LEFT

config ZMK_KEYBOARD_NAME
    default "Sheriff"

config ZMK_SPLIT_ROLE_CENTRAL
    default y
endif

if SHIELD_SHERIFF_LEFT || SHIELD_SHERIFF_RIGHT
config ZMK_SPLIT
    default y

endif
```
